## linux/security/azure_sphere/Kconfig
```kconfig
config SECURITY_AZURE_SPHERE
	bool "Azure Sphere LSM support"
	depends on SECURITY
	default n
	help
	  This enables the Azure Sphere LSM.

config EXTENDED_LSM
	bool "extended LSM support"
	depends on SECCOMP
	depends on SECURITY
	default y
	help
		This selects an extension to Azure Sphere LSM for seccomp-based sandboxing.

config EXTENDED_LSM_DIFC
	bool "supports difc model based LSM"
	depends on EXTENDED_LSM
	default y
	help
		This adds difc support to the extended Azure Sphere LSM.

config AZURE_SPHERE_MMAP_EXEC_PROTECTION
	bool "Azure Sphere mmap protection"
	depends on SECURITY_AZURE_SPHERE
	default y
	help
		This enables memory protections to protect writable pages from being made executable




		
```
